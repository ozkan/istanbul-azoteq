&i2c0 {
    compatible = "nordic,nrf-twi";
    pinctrl-0 = <&i2c0_default>;
    pinctrl-1 = <&i2c0_sleep>;
    pinctrl-names = "default", "sleep";
	clock-frequency = <I2C_BITRATE_FAST>;
	status = "okay";
    tps65: trackpad@74 {
          compatible = "azoteq,tps65";
          reg = <0x74>;
          
          /* 65mm trackpad variant per datasheet */
          variant = "65mm";
          
          /* Resolution per TPS65 datasheet: 3072 x 2048 */
          resolution-x = <3072>;
          resolution-y = <2048>;
          
          /* GPIO connections for trackpad control - avoid conflicts with matrix pins */
          int-gpios = <&gpio0 6 GPIO_ACTIVE_HIGH>;  /* INT pin for interrupt mode */
          rst-gpios = <&gpio0 8 GPIO_ACTIVE_HIGH>;  /* RST pin for hardware reset */
          
          /* Touch sensitivity and behavior */
          touch-threshold = <40>;        /* Lower = more sensitive */
          max-touches = <5>;             /* 1-5 simultaneous touches */
          palm-reject-threshold = <100>; /* Ignore touches larger than this */
          
          /* Enable gesture recognition */
          gesture-enable;
          
          /* Communication timeout */
          i2c-timeout-ms = <10>;
      };
};


