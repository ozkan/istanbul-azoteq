/*
 * Copyright (c) 2025 The ZMK Contributors
 *
 * SPDX-License-Identifier: MIT
 */


#include "istanbul.dtsi"




&kscan0 {
    col-gpios
        = <&gpio0 31 GPIO_ACTIVE_HIGH> // col1
        , <&gpio0 29 GPIO_ACTIVE_HIGH>  // col2
        , <&gpio0 2  GPIO_ACTIVE_HIGH>   // col3
        , <&gpio1 15 GPIO_ACTIVE_HIGH> // col4
        , <&gpio1 13 GPIO_ACTIVE_HIGH>  // col5
        , <&gpio1 11 GPIO_ACTIVE_HIGH>  // col6
        ;
};



&pro_micro_i2c {
    status = "okay";
    clock-frequency = <I2C_BITRATE_FAST>;
    tps65: trackpad@74 {
        compatible = "azoteq,tps65";
        reg = <0x74>;
        int-gpios = <&pro_micro 4 GPIO_ACTIVE_HIGH>;

        /* Diğer parametreler */
    };
};