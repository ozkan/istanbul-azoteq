## boards/shields/istanbul/Kconfig.defconfig
```kconfig
# Copyright (c) 2025 The ZMK Contributors
# SPDX-License-Identifier: MIT


if SHIELD_ISTANBUL_RIGHT

config ZMK_KEYBOARD_NAME
    default "Istanbul"

config ZMK_SPLIT_ROLE_CENTRAL
    default y

    

config IQS5XX
    bool
    default y

# enable pointing
config ZMK_POINTING
    default y

config INPUT
    default y

endif


if SHIELD_ISTANBUL_LEFT || SHIELD_ISTANBUL_RIGHT

config ZMK_SPLIT
    default y

endif
```

## config/boards/shields/istanbul/Kconfig.shield
```kconfig
# Copyright (c) 2025 The ZMK Contributors
# SPDX-License-Identifier: MIT

rsource "../../../drivers/sensor/Kconfig"



config SHIELD_ISTANBUL_LEFT
    def_bool $(shields_list_contains,istanbul_left)
    depends on DT_HAS_AZOTEQ_TPS65_ENABLED
    
config SHIELD_ISTANBUL_RIGHT
    def_bool $(shields_list_contains,istanbul_right)
```

## config/west.yml
```yaml
manifest:
  remotes:
    - name: zmkfirmware
      url-base: https://github.com/zmkfirmware
    - name: ahmed-m-osman1
      url-base: https://github.com/Ahmed-M-Osman1
  projects:
    - name: zmk
      remote: zmkfirmware
      revision: main
      import: app/west.yml
    - name: zmk-driver-azoteq
      remote: ahmed-m-osman1
      # branch
      revision: rotate-90-2
  self:
    path: config
```
